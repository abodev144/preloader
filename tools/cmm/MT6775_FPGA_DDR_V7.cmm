
&NR_RNKS=2
;EMI
;0x1033_6***

;DRAMC
;0x1033_2***

;DDRPHY
;0x1033_5***

;EMI setting
D.S SD:0x10230000 %LE %LONG 0x3010;
D.S SD:0x10230060 %LE %LONG 0xff000400;
D.S SD:0x10230068 %LE %LONG 0x00100000;
D.S SD:0x10335000 %LE %LONG 0x4002010;
D.S SD:0x10335010 %LE %LONG 0x01;


D.S SD:0x103321EC %LE %LONG 0x10101003;
wait 1.ms
D.S SD:0x1033207C %LE %LONG 0x0283488c;
D.S SD:0x10332054 %LE %LONG 0x00005180;
D.S SD:0x103321E8 %LE %LONG 0x2d000001;

D.S SD:0x1033000C %LE %LONG 0x10101010;
D.S SD:0x10330010 %LE %LONG 0x10101010;
D.S SD:0x1033006C %LE %LONG 0x10101010;
D.S SD:0x10330070 %LE %LONG 0x10101010;
D.S SD:0x10330184 %LE %LONG 0x21000000;
D.S SD:0x1033018C %LE %LONG 0x10101010;
D.S SD:0x10330014 %LE %LONG 0x0000061e;
D.S SD:0x10330018 %LE %LONG 0x00001010;
D.S SD:0x1033001C %LE %LONG 0x01111010;
D.S SD:0x10330020 %LE %LONG 0x01031001;
D.S SD:0x1033001C %LE %LONG 0x03111010;
D.S SD:0x1033003C %LE %LONG 0x00002828;

D.S SD:0x10330058 %LE %LONG 0x00001010;
D.S SD:0x10330074 %LE %LONG 0x0000061e;
D.S SD:0x10330078 %LE %LONG 0x00001010;
D.S SD:0x1033007C %LE %LONG 0x01111010;
D.S SD:0x10330080 %LE %LONG 0x01031001;
D.S SD:0x1033007C %LE %LONG 0x03111010;
D.S SD:0x1033009C %LE %LONG 0x00001010;
D.S SD:0x103300B8 %LE %LONG 0x00001010;
D.S SD:0x10330180 %LE %LONG 0x00000000;
D.S SD:0x10330184 %LE %LONG 0x21000000;
D.S SD:0x10330188 %LE %LONG 0x000001e2;

D.S SD:0x10330400 %LE %LONG 0x00000022;
D.S SD:0x10330404 %LE %LONG 0x00000000;
D.S SD:0x10330408 %LE %LONG 0x00000000;
D.S SD:0x1033040C %LE %LONG 0x00000000;
D.S SD:0x10330410 %LE %LONG 0x00000000;
D.S SD:0x10330414 %LE %LONG 0x00000000;
D.S SD:0x10330418 %LE %LONG 0x00000000;
D.S SD:0x1033041C %LE %LONG 0x00000000;
D.S SD:0x10330420 %LE %LONG 0xaa000040;
D.S SD:0x10330424 %LE %LONG 0x00000000;
D.S SD:0x10330428 %LE %LONG 0x00000000;
D.S SD:0x1033042C %LE %LONG 0x00000000;
D.S SD:0x10330430 %LE %LONG 0xffff0003;
D.S SD:0x10330434 %LE %LONG 0xffff0000;
D.S SD:0x10330438 %LE %LONG 0x00000c0c;
D.S SD:0x1033043C %LE %LONG 0x00660600;
D.S SD:0x10330440 %LE %LONG 0x00660600;
D.S SD:0x10330444 %LE %LONG 0x80690608;
D.S SD:0x10330448 %LE %LONG 0xc0690608;
D.S SD:0x1033044C %LE %LONG 0x00000000;
D.S SD:0x10330450 %LE %LONG 0x00000000;
D.S SD:0x10330454 %LE %LONG 0x00000000;
D.S SD:0x10330458 %LE %LONG 0x00000000;
D.S SD:0x10330460 %LE %LONG 0x00000000;
D.S SD:0x10330468 %LE %LONG 0x00000000;
D.S SD:0x10330088 %LE %LONG 0x00000000;
D.S SD:0x10330028 %LE %LONG 0x00000000;
D.S SD:0x10330454 %LE %LONG 0x00000000;
wait 1.ms
D.S SD:0x10330454 %LE %LONG 0x00010000;
wait 1.ms
D.S SD:0x10330404 %LE %LONG 0x80000000;
wait 1.ms
D.S SD:0x10330438 %LE %LONG 0x00008c8c;
wait 1.ms
D.S SD:0x1033043C %LE %LONG 0x00660e00;
D.S SD:0x10330440 %LE %LONG 0x00660e00;
D.S SD:0x10330444 %LE %LONG 0x80690e08;
D.S SD:0x10330448 %LE %LONG 0xc0690e08;
wait 1.ms
D.S SD:0x10330430 %LE %LONG 0xffff0000;
D.S SD:0x10330014 %LE %LONG 0x0000271e;
D.S SD:0x10330074 %LE %LONG 0x0000071e;

;To DRAMC
D.S SD:0x10332438 %LE %LONG 0x33333300;
D.S SD:0x1033243C %LE %LONG 0x51515100;
D.S SD:0x10332400 %LE %LONG 0x00000000;
D.S SD:0x10332404 %LE %LONG 0x00303000;
D.S SD:0x10332430 %LE %LONG 0x22223300;
;gated
D.S SD:0x10332434 %LE %LONG 0x51515100;
;D.S SD:0x10332434 %LE %LONG 0x62626200;

D.S SD:0x10332418 %LE %LONG 0x00020335;
D.S SD:0x10332408 %LE %LONG 0x00000000;
D.S SD:0x1033240C %LE %LONG 0x00000000;
;gated
D.S SD:0x10332410 %LE %LONG 0x55455545;
;D.S SD:0x10332410 %LE %LONG 0x56855545;

D.S SD:0x1033241C %LE %LONG 0x11112222;
D.S SD:0x10332420 %LE %LONG 0x11112222;
D.S SD:0x10332440 %LE %LONG 0x33333333;
D.S SD:0x10332444 %LE %LONG 0x33333333;
D.S SD:0x10332448 %LE %LONG 0x77777777;
D.S SD:0x1033244C %LE %LONG 0x44444444;
D.S SD:0x10332424 %LE %LONG 0x11112222;

;DQ dly
D.S SD:0x10332428 %LE %LONG 0x000f0a0a;
;DQS dly
D.S SD:0x1033242C %LE %LONG 0x00050055;
D.S SD:0x10332458 %LE %LONG 0x00ff00f0;
D.S SD:0x10332454 %LE %LONG 0xa0000000;

D.S SD:0x103321E0 %LE %LONG 0x00000000;
D.S SD:0x103321F8 %LE %LONG 0x040000c1;
D.S SD:0x103321C4 %LE %LONG 0x30430000;
D.S SD:0x1033223C %LE %LONG 0x00000000;

;refresh setting
D.S SD:0x10332008 %LE %LONG 0x00403318;
D.S SD:0x103321dc %LE %LONG 0x90182840;

D.S SD:0x103321E8 %LE %LONG 0x2d000001;
D.S SD:0x10332048 %LE %LONG 0x2200110d;
D.S SD:0x1033208C %LE %LONG 0x00000001;
D.S SD:0x103320D8 %LE %LONG 0x00100510;
D.S SD:0x103320E4 %LE %LONG 0x00082023;
D.S SD:0x103320B8 %LE %LONG 0x99169952;
D.S SD:0x103320BC %LE %LONG 0x99109950;
D.S SD:0x10332090 %LE %LONG 0x00000000;
D.S SD:0x103320DC %LE %LONG 0x83000000;

D.S SD:0x103320E0 %LE %LONG 0x10000000;
D.S SD:0x10332118 %LE %LONG 0x00000000;
D.S SD:0x103320F0 %LE %LONG 0x10000000;
D.S SD:0x103325C0 %LE %LONG 0x0100000c;
D.S SD:0x103320F4 %LE %LONG 0x01000000;
D.S SD:0x10332168 %LE %LONG 0x00000000;
D.S SD:0x10332130 %LE %LONG 0x70000000;
D.S SD:0x103320D8 %LE %LONG 0x00300510;
D.S SD:0x10332004 %LE %LONG 0xf00086a3;
D.S SD:0x10332124 %LE %LONG 0xc0000011;
D.S SD:0x10332138 %LE %LONG 0x00b08000;
D.S SD:0x10332094 %LE %LONG 0x00000000;
D.S SD:0x10332098 %LE %LONG 0x00000000;
D.S SD:0x103321C0 %LE %LONG 0x11110000;
D.S SD:0x10332240 %LE %LONG 0x00000008;

D.S SD:0x10332000 %LE %LONG 0x668e4719;
D.S SD:0x103320FC %LE %LONG 0x17030000;
D.S SD:0x103321F8 %LE %LONG 0x040000c1;
D.S SD:0x103321EC %LE %LONG 0x10000003;
D.S SD:0x1033207C %LE %LONG 0x0781548c;

;20:16 DATA LATENCY - Important setting
;There are 4 stage read data fifo
;D.S SD:0x10332080 %LE %LONG 0x70070700;
;D.S SD:0x10332080 %LE %LONG 0x70090700;
D.S SD:0x10332080 %LE %LONG 0x70070700;

D.S SD:0x10332028 %LE %LONG 0xd0000000;
D.S SD:0x103321E8 %LE %LONG 0x2d000001;
D.S SD:0x10332158 %LE %LONG 0x00000000;
D.S SD:0x10332110 %LE %LONG 0x00697780;
D.S SD:0x10332004 %LE %LONG 0xf07486a3;
D.S SD:0x103320E4 %LE %LONG 0x00000027;

;ERIC
;MRS
wait 1.ms

D.S SD:0x103321E4 %LE %LONG 0x00000000;
D.S SD:0x10332088 %LE %LONG 0x0000000d;
D.S SD:0x103321E4 %LE %LONG 0x00000001;
wait 1.ms

D.S SD:0x103321E4 %LE %LONG 0x00000000;
;ODT
D.S SD:0x10332088 %LE %LONG 0x0000000b;
D.S SD:0x103321E4 %LE %LONG 0x00000001;
wait 1.ms

D.S SD:0x103321E4 %LE %LONG 0x00000000;
D.S SD:0x10332088 %LE %LONG 0x00540001;
D.S SD:0x103321E4 %LE %LONG 0x00000001;
wait 1.ms

D.S SD:0x103321E4 %LE %LONG 0x00000000;
D.S SD:0x10332088 %LE %LONG 0x00120002;
D.S SD:0x103321E4 %LE %LONG 0x00000001;
wait 1.ms

D.S SD:0x103321E4 %LE %LONG 0x00000000;
D.S SD:0x10332088 %LE %LONG 0x00310003;
D.S SD:0x103321E4 %LE %LONG 0x00000001;
wait 1.ms

;MRR
;D.S SD:0x103321E4 %LE %LONG 0x00000000;
;D.S SD:0x10332088 %LE %LONG 0x00000004;
;D.S SD:0x103321E4 %LE %LONG 0x00000002;
;wait 1.ms

;MRR12
;D.S SD:0x103321E4 %LE %LONG 0x00000000;
;D.S SD:0x10332088 %LE %LONG 0x003A000c;
;D.S SD:0x103321E4 %LE %LONG 0x00000001;
;wait 1.ms

;D.S SD:0x103321E4 %LE %LONG 0x00000000;
;D.S SD:0x10332088 %LE %LONG 0x0000000c;
;D.S SD:0x103321E4 %LE %LONG 0x00000002;
;wait 1.ms

;dramc selftest
;D.S SD:0x1033203c %LE %LONG 0x01800000;
;D.S SD:0x10332040 %LE %LONG 0x00000040;
;D.S SD:0x10332008 %LE %LONG 0x83406340;

;D.S SD:0x103321E4 %LE %LONG 0x00050000;
;D.S SD:0x10332110 %LE %LONG 0x00697780;
;D.S SD:0x103321DC %LE %LONG 0xd0625440;
;D.S SD:0x103320E4 %LE %LONG 0x00002123;
;D.S SD:0x103321EC %LE %LONG 0x10100003;
;D.S SD:0x10332088 %LE %LONG 0x0001000d;
;D.S SD:0x103321E4 %LE %LONG 0x00000001;
;wait 1.ms

;D.S SD:0x103321E4 %LE %LONG 0x00000000;
;D.S SD:0x103320E4 %LE %LONG 0x0008202b;
;D.S SD:0x10332008 %LE %LONG 0x10403300;
;D.S SD:0x103321DC %LE %LONG 0xd0005440;
;D.S SD:0x103320D8 %LE %LONG 0x00002000;
;D.S SD:0x1033213C %LE %LONG 0xfd501005;
;D.S SD:0x1033213C %LE %LONG 0xfd501105;
;D.S SD:0x1033213C %LE %LONG 0xfd501005;
;D.S SD:0x103325C0 %LE %LONG 0x0107000c;
;D.S SD:0x103321E4 %LE %LONG 0x00000020;
;wait 1.ms
;D.S SD:0x103321E4 %LE %LONG 0x00000000;
;D.S SD:0x103325C0 %LE %LONG 0x0001000c;
;wait 1.ms

;self test
;D.S SD:0x10332044 %LE %LONG 0xbf050480;
;D.S SD:0x103321E8 %LE %LONG 0xa9ff2d61;
;D.S SD:0x10332008 %LE %LONG 0x00600000;
;D.S SD:0x10332100 %LE %LONG 0x00000000;
;D.S SD:0x103321DC %LE %LONG 0xc3657073;
;D.S SD:0x10332348 %LE %LONG 0x00010008;



